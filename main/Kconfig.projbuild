## main/Kconfig.projbuild
```kconfig
menu "Example Configuration"

    config ESP_WIFI_SSID
        string "WiFi SSID"
        default "esp8266"
        help
            SSID (network name) for the example to connect to.

    config ESP_WIFI_PASSWORD
        string "WiFi Password"
        default "mypassword"
        help
            WiFi password (WPA or WPA2) for the example to use.

    config ESP_MAXIMUM_RETRY
        int "Maximum retry"
        default 5
        help
            Set the Maximum retry to avoid station reconnecting to the AP unlimited when the AP is really inexistent.

    config BROKER_URL
        string "Broker URL"
        default "mqtt://mqtt.eclipse.org"
        help
            URL of the broker to connect to

    config BROKER_USER
        string "Broker username"
        help
            MQTT username

    config BROKER_PASSWORD
        string "Broker password"
        help
            MQTT password
endmenu
```
